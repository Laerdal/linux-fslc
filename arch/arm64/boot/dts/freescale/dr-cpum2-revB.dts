/*
 * Copyright DATA RESPONS AS
 *
 * The code contained herein is licensed under the GNU General Public
 * License. You may obtain a copy of the GNU General Public License
 * Version 2 or later at the following locations:
 *
 * http://www.opensource.org/licenses/gpl-license.html
 * http://www.gnu.org/copyleft/gpl.html
 */
/dts-v1/;

#include <dt-bindings/input/input.h>
#include <dt-bindings/gpio/gpio.h>
#include <dt-bindings/usb/pd.h>
#include "imx8mp-nominal.dtsi"
#include "dr-cpum2-revB.dtsi"

&media_blk_ctrl {
	power-domains = <&pgc_mediamix>,
			<&pgc_mipi_phy1>,
			<&pgc_mipi_phy1>,
			<&pgc_mediamix>,
			<&pgc_mediamix>,
			<&pgc_mipi_phy2>,
			<&pgc_mediamix>,
			<&pgc_mipi_phy2>;
	power-domain-names = "bus", "mipi-dsi1", "mipi-csi1",
			     "lcdif1", "isi", "mipi-csi2",
			     "lcdif2", "mipi-dsi2";
};
